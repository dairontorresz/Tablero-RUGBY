
			.syntax unified
			.text
			.global increm
			.thumb_func

#define		VARA	 R0 //0
#define		VARB	 R1 //0
#define		PORTF	 R2 //
#define     PULUP    R3 //0x01


increm:	
			PUSH 	{LR}  					/* guardamos la direccion de retorno en la pila */
			
			B       COMP         	//COMPARA SI LLEGA A 84

CONTINUAR:	CMP     PORTF, #0x02       //MIRA SI SE ESTA PULSANDO P2
			BEQ		CARGAP2         //SI SE PULSA LO GUARDA EN R5
			CMP     PORTF, #0x01       //MIRA SI SE ESTA PULSANDO P1 
			BEQ		CARGAP1         //SI SE PULSA LO GUARDA EN R5

NEXT:		LDR     R9, [PULUP]
			CMP     R9, #0x02       //PREGUNTA SI LO ULTIMO QUE SE PULSO FUE P2
			BEQ     BOTONP2
			CMP     R9, #0x01       //PREGUNTA SI LO ULTIMO QUE SE PULSO FUE P1
			BEQ     BOTONP1
			B       BOTONP1
			
CARGAP2:    LDR     R9, [PULUP]
			MOV     R9, #0x02
			STR     R9, [PULUP]
			B       NEXT
			
CARGAP1:    LDR     R9, [PULUP]
            MOV     R9, #0x01
			STR     R9, [PULUP]
			B       NEXT
			
BOTONP1:    LDR     R10, [VARA]   	//CARGA LA POSICION DE CONTA
			ADD		R10, #1      	//LE SUMA UNO A LAS UNIDADES
			STR     R10, [VARA]     	//GUARDA LA SUMA EN CONTA
			CMP		R10, #10       	//COMPARA SI ES 9
			BEQ		RESETUNI_ASC    //SI 
			B		FIN      //SI NO ES MENOR A 9 HACE UN CICLO DE SUMA Y VA A HACER UN CICLO DE RESTA 
			
BOTONP2:	
			LDR     R10, [VARA]    	//LEE LO QUE TIENE CONTA Y LO GUARDA EN R1
			
			CMP     R10, #0x01       //COMPARA SI ES IMPAR Y LE RESTA UNO PARA VOLVER EL NUMERO PAR Y SUMAR PARES
			BEQ     VOLVPAR
			CMP     R10, #0x03
			BEQ     VOLVPAR
			CMP     R10, #0x05
			BEQ     VOLVPAR
			CMP     R10, #0x07
			BEQ     VOLVPAR
			CMP     R10, #0x09
			BEQ     VOLVPAR
			
CONPAR:     
			LDR     R10, [VARA]    	//LEE LO QUE TIENE CONTA Y LO GUARDA EN R1
			ADD		R10, #2      	//LE SUMA DOS A LAS UNIDADES
			STR     R10, [VARA]     	//GUARDA LA SUMA EN CONTA
			CMP		R10,#10       //COMPARA SI ES 10
			BEQ		RESETUNI_ASC
			CMP		R10,#11       //COMPARA SI ES 11
			BEQ		RESETUNI_ASC
			CMP		R10,#12       //COMPARA SI ES 12
			BEQ		RESETUNI_ASC
			B		FIN   //SI NO ES MENOR A 9 HACE UN CICLO DE SUMA Y VA A HACER UN CICLO DE RESTA 

VOLVPAR:	SUB		R10, #1      	//LE SUMA UNO A LAS UNIDADES
			STR     R10, [VARA]     	//GUARDA LA SUMA EN CONTA
			B       CONPAR

COMP:	    LDR     R10,[VARB]    //COGE LO QUE TIENE B Y LO PASA A R10
			CMP		R10,#8        //COMPARA SI LAS DECENAS LLEGA A 8
			BEQ		COMP_UNI     //SI LAS DECENAS LLEGA A O VA A COMPARAR LAS UNIDADES
			B       CONTINUAR
			
COMP_UNI:   LDR     R10, [VARA]   //CARGA LA POSICION DE CONTA
			CMP		R10,#4        //CONPARA SI LAS UNIDADES SON A 4
			BEQ		REIN_TOTAL   //SI SE CUMPLE LOS REINICIA LOS DOS EN CERO
			B       CONTINUAR
			
REIN_TOTAL: //REINICIA LAS UNIDADES CUANDO LLEGA A 84
			LDR 	R10, [VARA]    //CARGA LA DIRECCION DE MEMORIA DE CONTA
			MOV 	R11, #0x00  	  //CARGO EL NUMERO CERO EN R2
			STR     R11, [VARA]		  //GUARDA EL 00 EN CONTA
           //REINICIA LAS DECENAS
			LDR 	R10, [VARB]    //CARGA LA DIRECCION DE MEMORIA DE CONTB
			MOV 	R11, #0x00  	  //CARGO EL NUMERO CERO EN R2
			STR     R11, [VARB]		  //GUARDA EL 00 EN CONTB
			B       FIN     //AL REINICIARSE TOTAL YA HIZO UN CILO DE SUMA Y VA A UNO DE RESTA
			
RESETUNI_ASC://REINICIA LAS UNIDADES
			MOV 	R11, #0x00  	  //CARGO EL NUMERO CERO EN R2
			STR     R11, [VARA]		  //GUARDA EL 00 EN CONTA
			//AUMENTA LAS DECENAS
			LDR     R10, [VARB]      //LEE LO QUE TIENE CONTB Y LO GUARDA EN R1
			ADD		R10, #1        //LE SUMA UNO A LAS DECENAS
			STR     R10, [VARB]      //GUARDA R1 EN CONTB
			CMP		R10,#9         //COMPARA SI LAS DECENAS LLEGA A   8
			BEQ		RESETDEC_ASC  //SI LAS DECENAS LLEGAN A 8 SE REINICIAN 
			B		FIN

RESETDEC_ASC://REINICIA LAS DECENAS
			MOV 	R11, #0x00  	  //CARGO EL NUMERO CERO EN R2
			STR     R11, [VARB]		  //GUARDA EL 00 EN CONTB
			B		FIN     //REINICIA TODO
					 
FIN:		
			POP 	{PC}   				/* retorno   */