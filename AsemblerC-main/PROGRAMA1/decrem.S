
			.syntax unified
			.text
			.global decrem
			.thumb_func

#define		VARC	 R0 
#define		VARD	 R1 
#define		PORTF	 R2 
#define     PULDOWN  R3  

decrem:	
			PUSH 	{LR}  					/* guardamos la direccion de retorno en la pila */
			
			CMP     PORTF, #0x08       //MIRA SI SE ESTA PULSANDO P8
			BEQ		CARGAP4         //SI SE PULSA LO GUARDA EN PULDOWM
			CMP     PORTF, #0x04       //MIRA SI SE ESTA PULSANDO P4 
			BEQ		CARGAP3         //SI SE PULSA LO GUARDA EN PULDOWN

NEXTRES:	LDR     R9, [PULDOWN]
			CMP     R9, #0x08       //PREGUNTA SI LO ULTIMO QUE SE PULSO FUE P8
			BEQ     BOTONP4
			CMP     R9, #0x04       //PREGUNTA SI LO ULTIMO QUE SE PULSO FUE P4
			BEQ     BOTONP3
			B       BOTONP3

CARGAP4:    MOV     R9, #0x08      // CARGA EL BOTON 8 AL PULSADOR DE ESTADO
			STR     R9, [PULDOWN]
			B       NEXTRES
			
CARGAP3:    MOV     R9, #0x04
			STR     R9, [PULDOWN]
			B       NEXTRES

BOTONP3:	LDR     R10, [VARC]     
			SUB		R10, #1       //LE RESTA UNO A LAS UNIDADES
			STR     R10, [VARC]     
			CMP		R10, #00      //CONPARA SI ES 0
			BMI		RESETU_DES   //SI ES CERO REINICIA LAS UNIDADES
			B		FIN          //SI NO ES CERO AUN FINALIZA

BOTONP4:    LDR     R10, [VARC]     //LEE LO QUE TIENE CONTC Y LO GUARDA EN R10
			
			CMP     R10, #0x02    //MIRA SI ES PAR Y LO VUELVE IMPAR
			BEQ     VOLVIMP
			CMP     R10, #0x04
			BEQ     VOLVIMP
			CMP     R10, #0x06
			BEQ     VOLVIMP
			CMP     R10, #0x08
			BEQ     VOLVIMP
			
CONTIMP:	LDR     R11, [VARC]     //LEE LO QUE TIENE CONTC Y LO GUARDA EN R1
			SUB		R11, #2       //LE RESTA UNO A LAS UNIDADES
			STR     R11, [VARC]     //GUARDA LA RESTA EN CONTC
			CMP		R11, #00      //CONPARA SI ES 0
			BMI		RESETU_DES   //SI ES CERO REINICIA LAS UNIDADES
			B		FIN  //SI NO ES CERO AUN, HACE UN CILO DE RESTA Y VA A HACER UN CICLO DE SUMA
	
VOLVIMP:    ADD     R10, #0x01
			STR     R10, [VARC]
			B       CONTIMP

RESETU_DES:	//REINICIA LAS UNIDADES
			LDR 	R11,[VARC]    //CARGA LA DIRECCION DE MEMORIA DE CONTC
			MOV 	R9, #0x09  	  //CARGO EL NUMERO 9 EN R2
			STR     R9, [VARC]		  //GUARDA EL 09 EN CONTC
			//DISMINUYE LAS DECENAS
			
			LDR     R10, [VARD]      //LEE LO QUE TIENE CONTD Y LO GUARDA EN R1
			SUB		R10, #1        //LE RESTA UNO A LAS DECENAS
			STR     R10, [VARD]      //GUARDA R1 EN CONTD
			CMP		R10, #0        //COMPARA SI LAS DECENAS LLEGA A   0
			BMI		RESETD_DES    //SI LAS DECENAS LLEGAN A 0 SE REINICIAN 
			B		FIN   //SI NO SON CERO YA HIZO UN CILO DE RESTA Y VA A HACER UNO DE SUMA

RESETD_DES:  //REINICIA LAS DECENAS
			LDR 	R10,[VARD]    //CARGA LA DIRECCION DE MEMORIA DE CONTD
			MOV 	R9, #0x08  	  //CARGO EL NUMERO 9 EN R2
			STR     R9, [VARD]		  //GUARDA EL 9 EN CONTD
			//REINICIA LAS UNIDADES EN 4
			LDR 	R10,[VARC]      //CARGA LA DIRECCION DE MEMORIA DE CONTC
			MOV 	R9, #0x04  		//CARGO EL NUMERO 4 EN R1
			STR     R9, [VARC]			//GUARDA EL 00 EN CONTA
			
FIN:
			POP 	{PC}   				/* retorno   */
			